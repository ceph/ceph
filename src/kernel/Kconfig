## src/kernel/Kconfig
```kconfig
config CEPH_FS
        tristate "Ceph distributed file system (EXPERIMENTAL)"
	depends on INET && EXPERIMENTAL
	select LIBCRC32C
	help
	  Choose Y or M here to include support for mounting the
	  experimental Ceph distributed file system.  Ceph is an extremely
	  scalable file system designed to provide high performance,
	  reliable access to petabytes of storage.

	  More information at http://ceph.newdream.net/.

	  If unsure, say N.
```

## trunk/ceph/kernel/kconfig.patch
```kconfig
diff -ur linux-2.6.23-orig/fs/Kconfig linux-2.6.23/fs/Kconfig
--- linux-2.6.23-orig/fs/Kconfig	2007-10-09 13:31:38.000000000 -0700
+++ linux-2.6.23/fs/Kconfig	2007-11-29 09:57:23.158707666 -0800
@@ -1519,6 +1519,13 @@
 menu "Network File Systems"
 	depends on NET
 
+config CEPH_FS
+        tristate "Ceph distributed file system (EXPERIMENTAL)"
+	depends on INET && EXPERIMENTAL
+	help
+	  See http://ceph.sf.net/
+
+
 config NFS_FS
 	tristate "NFS file system support"
 	depends on INET
diff -ur linux-2.6.23-orig/fs/Makefile linux-2.6.23/fs/Makefile
--- linux-2.6.23-orig/fs/Makefile	2007-10-09 13:31:38.000000000 -0700
+++ linux-2.6.23/fs/Makefile	2007-11-29 09:54:16.152050764 -0800
@@ -118,3 +118,4 @@
 obj-$(CONFIG_DEBUG_FS)		+= debugfs/
 obj-$(CONFIG_OCFS2_FS)		+= ocfs2/
 obj-$(CONFIG_GFS2_FS)           += gfs2/
+obj-$(CONFIG_CEPH_FS)           += ceph/
```
